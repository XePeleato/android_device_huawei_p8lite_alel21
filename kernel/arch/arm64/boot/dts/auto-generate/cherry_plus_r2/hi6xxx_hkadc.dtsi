/{
    /*HKADC:电压读取驱动模块*/
	hkadc {
		compatible = "hisilicon,hi6xxx-hkadc-driver";
		/*HKADC逻辑通道->物理通道的映射关系*/
		hkadc-l2p-table = <0xa 0x6 0x5 0xffffffff 0xffffffff 0xffffffff 0xffffffff 0xffffffff 0xffffffff 0x8 0x9 0xb 0xffffffff 0xffffffff 0xc 0x9>;
	};
};