/*
 *  Copyright (C) 2013 Huawei co Ltd.
 *
 *  This program is free software; you can redistribute it and/or modify
 *  it under the terms of the GNU General Public License version 2 as
 *  publishhed by the Free Software Foundation.
 */

/ {
    bluetooth_power:bluetooth_power{
        compatible = "huawei,bluetooth_power";
        huawei,bt_en = <&gpio_bt_en>;
        huawei,ck32b = "CK32B";
        pinctrl-names = "default", "idle";
        pinctrl-0 = <&gpio035_cfg_func
                    &gpio011_cfg_func
                    &gpio031_cfg_func>;
        pinctrl-1 = <&gpio035_cfg_idle
                    &gpio011_cfg_idle
                    &gpio031_cfg_idle>;
        status = "ok";
    };

	bluetooth_sleep:bluetooth_sleep{
        compatible = "huawei,bluetooth_sleep";
        huawei,bt_wake_host = <&gpio_bt_wakeup_ap>;
        huawei,host_wake_bt = <&gpio_ap_wakeup_bt>;
        status = "ok";
    };
};
