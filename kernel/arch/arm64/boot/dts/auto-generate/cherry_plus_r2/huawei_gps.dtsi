/*
 *  Copyright (C) 2013 Huawei co Ltd.
 *
 *  This program is free software; you can redistribute it and/or modify
 *  it under the terms of the GNU General Public License version 2 as
 *  publishhed by the Free Software Foundation.
 */

/ {
    gps_power:gps_power{
        compatible = "huawei,gps_power";
        huawei,gps_en = <&gpio_gps_en>;
        clocks = <&CK32C>, <&clk_ssi_pad>, <&clk_ssi_pad_sel>;
        clock-names = "gps_32k", "ref_clk", "ref_clk_sel";
        pinctrl-names = "default", "idle";
        pinctrl-0 = <&gpio066_pmx_func>;
        pinctrl-1 = <&gpio066_pmx_idle>;
        /*broadcom configuration file use*/
        broadcom_config,gps_en = <29>;
    };
};
