/*
 *  Copyright (C) 2014 Hisilicon Ltd.
 *  Author: Bintian Wang <bintian.wang@huawei.com>
 *
 *  This program is free software; you can redistribute it and/or modify
 *  it under the terms of the GNU General Public License version 2 as
 *  publishhed by the Free Software Foundation.
 */

/dts-v1/;
/* NOTE:
 * The last reserved memory base is used in fastboot
 * Which should be the least reseve value
 */

/include/ "fastboot.dtsi"
/include/ "hi6220_cs_udp_ddr2_config.dtsi"
/include/ "hi6220_cs_udp_ddr3_pin.dtsi"
/include/ "hi6220_cs_udp_ddr3_gpio_logic.dtsi"
/include/ "hi6220_cs_udp_ddr3_pmic.dtsi"
/include/ "hi6220_cs_udp_ddr3_charger.dtsi"
/ {
	hisi,boardid = <0 0 4 3>;
	hisi,boardname = "hi6220_cs_udp_ddr3";

        ddr_min: ddrfreq {
		operating-points = <
			/* kHz uV */
			150000	0
			266000	0
			400000  0
			533000  0
			800000  0
		>;
	};

        ddr_max: ddrfreq_up_threshold {
                operating-points = <
			/* kHz uV */
			150000	0
			266000	0
			400000  0
			533000  0
			800000  0
		>;
	};
};
