/*
 *  Copyright (C) 2014 Hisilicon Ltd.
 *  Author: Bintian Wang <bintian.wang@huawei.com>
 *
 *  This program is free software; you can redistribute it and/or modify
 *  it under the terms of the GNU General Public License version 2 as
 *  publishhed by the Free Software Foundation.
 */

/dts-v1/;

/include/ "fastboot.dtsi"
/include/ "hi6220_cs_udp_ddr2_config.dtsi"
/include/ "hi6220_cs_udp_dsds_ddr2_pin.dtsi"
/include/ "hi6220_cs_udp_dsds_ddr2_gpio_logic.dtsi"
/include/ "hi6220_cs_udp_dsds_ddr2_pmic.dtsi"
/include/ "hi6220_cs_udp_dsds_ddr2_charger.dtsi"
/ {
	hisi,boardid = <0 0 5 4>;
	hisi,boardname = "hi6220_cs_udp_dsds_ddr2";
};
