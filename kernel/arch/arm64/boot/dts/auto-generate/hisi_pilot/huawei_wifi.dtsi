/*
 *  Copyright (C) 2013 Huawei co Ltd.
 *
 *  This program is free software; you can redistribute it and/or modify
 *  it under the terms of the GNU General Public License version 2 as
 *  publishhed by the Free Software Foundation.
 */

/ {
   bcm_wifi {
			compatible = "hisilicon,bcm_wifi";
			/*
			clocks = <&clk_pmu32kb>;
			clock-names = "apb_pclk";
			pinctrl-names = "default", "idle";
			pinctrl-0 = <&gpio160_cfg_func &gpio212_cfg_func >;
			pinctrl-1 = <&gpio160_cfg_idle &gpio212_cfg_idle>;
			*/

		pinctrl-names = "default", "idle";
		pinctrl-0 = <&gpio120_cfg_func
			         &gpio121_cfg_func
			         &gpio122_cfg_func
			         &gpio123_cfg_func
			         &gpio124_cfg_func
			         &gpio125_cfg_func
				 &gpio120_pmx_func
			         &gpio121_pmx_func
			         &gpio122_pmx_func
			         &gpio123_pmx_func
			         &gpio124_pmx_func
			         &gpio125_pmx_func>;
		pinctrl-1 = <&gpio120_cfg_idle
			         &gpio121_cfg_idle
			         &gpio122_cfg_idle
			         &gpio123_cfg_idle
			         &gpio124_cfg_idle
			         &gpio125_cfg_idle
				 &gpio120_pmx_idle
			         &gpio121_pmx_idle
			         &gpio122_pmx_idle
			         &gpio123_pmx_idle
			         &gpio124_pmx_idle
			         &gpio125_pmx_idle>;

			wlan-on,gpio-enable= <&gpio_wl_en>;
			wlan-irq,gpio-irq = <&gpio_wl_wakeup_ap>;
			/*
			wifi_nvram_name = "/vendor/firmware/nvram4334_hw.txt";
			wifi_fw_name = "fw_bcm4343_hw.bin";
			*/
			wifi_fw_name= "/vendor/firmware/fw_bcm4343s_hw.bin";
			wifi_fw_ap_name = "/vendor/firmware/fw_bcm4343s_apsta_hw.bin";
			wifi_fw_p2p_name = "/vendor/firmware/fw_bcm4343s_p2p_hw.bin";
			wifi_fw_test_name = "/vendor/firmware/fw_bcm4343s_test_hw_apsta.bin";
	};
};
