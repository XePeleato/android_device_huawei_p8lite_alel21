/*
 *
 * Copyright (C), 1988-1999, Huawei Tech. Co., Ltd.
 * Author: l00213837 <lixiuna@huawei.com>
 *
 * This program is free software; you can redistribute it and/or modify
 * it under the terms of the GNU General Public License version 2 as
 * publishhed by the Free Software Foundation.
 */

/{
	otg_gpio_switch:otg_gpio_switch {
		compatible = "huawei,gpio_switch_otg";
		otg_int_gpio = <&gpio22 6 0>;
		status = "disable";
	};
};

