/*
 *  Copyright (C) 2013 Huawei co Ltd.
 *
 *  This program is free software; you can redistribute it and/or modify
 *  it under the terms of the GNU General Public License version 2 as
 *  publishhed by the Free Software Foundation.
 */

/ {
   bcm_wifi {
			compatible = "hisilicon,bcm_wifi";
			/*
			clocks = <&clk_pmu32kb>;
			clock-names = "apb_pclk";
			pinctrl-names = "default", "idle";
			pinctrl-0 = <&gpio160_cfg_func &gpio212_cfg_func >;
			pinctrl-1 = <&gpio160_cfg_idle &gpio212_cfg_idle>;
			*/
			wlan-on,gpio-enable= <&gpio2 3 0>;
			wlan-irq,gpio-irq = <&gpio2 4 0>;
			wifi_nvram_name = "nvram4343_hw.txt";
			wifi_fw_name = "fw_bcm4343_hw.bin";
	};
};
