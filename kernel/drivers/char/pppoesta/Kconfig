## kernel/drivers/char/pppoesta/Kconfig
```kconfig
#
# pppoesta device configuration
#

config PPPOESTA
           tristate "pppoe status Driver"
           default n
           help
           This is used to record the pppoe status.
```

## kernel/drivers/clk/hisilicon/Kconfig
```kconfig
config HI3xxx_CLK_CORE
	bool "Core clock driver of Hi3xxx Soc"
	default n if COMMON_CLK

config HI3620_CLK_MIPI_DSI
	bool "MIPI DSI clock driver of Hi3620 SoC"
	default y if COMMON_CLK && FB_HI3620

config HI3XXX_CLK
	bool "clock driver of Hi3635 and hi3650 Soc"
	default n

config HI3XXX_CLK_ALWAYS_ON
	bool "all clocks of Hisi Soc are always on"
	default n

config HI3XXX_CLK_MAILBOX_SUPPORT
	depends on HI3XXX_CLK
	depends on HI3XXX_MAILBOX
	bool "clk driver support mailbox communication"
	default n

config HI6XXX_CLK
	bool "Clock driver of Hi6620 and Hi6210 Soc"
	default n

config HI6XXX_CLK_ALWAYS_ON
	depends on HI6XXX_CLK
	bool "all clocks of Hi6620 Soc are always on"
	default n

config HISI_CLK_DEBUG 
	depends on COMMON_CLK_DEBUG
	bool "HiSilicon clock driver debug"
	default n
```

## kernel/drivers/coresight/Kconfig
```kconfig
config HISI_CS
	bool "CoreSight tracing"
	help
	  Enables support for CoreSight tracing. This uses CoreSight trace
	  components and buses to support both hardware (eg. processor ETM)
	  and hardware assisted software instrumentation based (eg. STM)
	  tracing.

	  For production builds, you should probably say 'N' here to avoid
	  potential power, performance and memory penalty.

config HISI_CS_STM_DEFAULT_ENABLE
	bool "Turn on CoreSight STM tracing by default"
	depends on HISI_CS
	help
	  Turns on CoreSight STM tracing (hardware assisted software
	  instrumentation based tracing) by default. Otherwise, tracing is
	  disabled by default but can be enabled via sysfs.

	  For production builds, you should probably say 'N' here to avoid
	  potential power, performance and memory penalty.

config HISI_CS_ETM_DEFAULT_ENABLE
	bool "Turn on CoreSight ETM tracing by default"
	depends on HISI_CS
	help
	  Turns on CoreSight ETM tracing (processor tracing) by default.
	  Otherwise, tracing is disabled by default but can be enabled via
	  sysfs.

	  For production builds, you should probably say 'N' here to avoid
	  potential power, performance and memory penalty.

config HISI_CS_ETM_PCSAVE_DEFAULT_ENABLE
	bool "Turn on PC saving by default"
	depends on HISI_CS
	help
	  Turns on program counter saving on reset by default. Otherwise,
	  PC saving is disabled by default but can be enabled via sysfs.

	  For production builds, you should probably say 'N' here to avoid
	  potential power penalty.

config CONTROL_TRACE
	tristate "Turn on to control tracing"
	help
	  Builds module to abort tracing on a user space data, instruction
	  or prefetch abort.

	  For production builds, you should probably say 'N' here to avoid
	  potential power, performance and memory penalty.
```

## kernel/drivers/devfreq/Kconfig
```kconfig
menuconfig PM_DEVFREQ
	bool "Generic Dynamic Voltage and Frequency Scaling (DVFS) support"
	help
	  A device may have a list of frequencies and voltages available.
	  devfreq, a generic DVFS framework can be registered for a device
	  in order to let the governor provided to devfreq choose an
	  operating frequency based on the device driver's policy.

	  Each device may have its own governor and policy. Devfreq can
	  reevaluate the device state periodically and/or based on the
	  notification to "nb", a notifier block, of devfreq.

	  Like some CPUs with CPUfreq, a device may have multiple clocks.
	  However, because the clock frequencies of a single device are
	  determined by the single device's state, an instance of devfreq
	  is attached to a single device and returns a "representative"
	  clock frequency of the device, which is also attached
	  to a device by 1-to-1. The device registering devfreq takes the
	  responsibility to "interpret" the representative frequency and
	  to set its every clock accordingly with the "target" callback
	  given to devfreq.

	  When OPP is used with the devfreq device, it is recommended to
	  register devfreq's nb to the OPP's notifier head.  If OPP is
	  used with the devfreq device, you may use OPP helper
	  functions defined in devfreq.h.

if PM_DEVFREQ

comment "DEVFREQ Governors"

config DEVFREQ_GOV_SIMPLE_ONDEMAND
	tristate "Simple Ondemand"
	help
	  Chooses frequency based on the recent load on the device. Works
	  similar as ONDEMAND governor of CPUFREQ does. A device with
	  Simple-Ondemand should be able to provide busy/total counter
	  values that imply the usage rate. A device may provide tuned
	  values to the governor with data field at devfreq_add_device().

config DEVFREQ_GOV_MALI_ONDEMAND
	tristate "Mali Ondemand"
	help
	  Base on simple ondemand governor.

config DEVFREQ_GOV_PERFORMANCE
	tristate "Performance"
	help
	  Sets the frequency at the maximum available frequency.
	  This governor always returns UINT_MAX as frequency so that
	  the DEVFREQ framework returns the highest frequency available
	  at any time.

config DEVFREQ_GOV_POWERSAVE
	tristate "Powersave"
	help
	  Sets the frequency at the minimum available frequency.
	  This governor always returns 0 as frequency so that
	  the DEVFREQ framework returns the lowest frequency available
	  at any time.

config DEVFREQ_GOV_USERSPACE
	tristate "Userspace"
	help
	  Sets the frequency at the user specified one.
	  This governor returns the user configured frequency if there
	  has been an input to /sys/devices/.../power/devfreq_set_freq.
	  Otherwise, the governor does not change the frequnecy
	  given at the initialization.

config DEVFREQ_GOV_PM_QOS
	bool "PM QOS"
	help
	  Sets the frequency based on pm_qos throughput constraints.

comment "DEVFREQ Drivers"

config ARM_EXYNOS4_BUS_DEVFREQ
	bool "ARM Exynos4210/4212/4412 Memory Bus DEVFREQ Driver"
	depends on CPU_EXYNOS4210 || CPU_EXYNOS4212 || CPU_EXYNOS4412
	select ARCH_HAS_OPP
	select DEVFREQ_GOV_SIMPLE_ONDEMAND
	help
	  This adds the DEVFREQ driver for Exynos4210 memory bus (vdd_int)
	  and Exynos4212/4412 memory interface and bus (vdd_mif + vdd_int).
	  It reads PPMU counters of memory controllers and adjusts
	  the operating frequencies and voltages with OPP support.
	  To operate with optimal voltages, ASV support is required
	  (CONFIG_EXYNOS_ASV).

config HI6XXX_DDR_DEVFREQ
	bool "Hisilicon ddr devfreq support"
	depends on PM_DEVFREQ && PM_OPP
	select DEVFREQ_GOV_PM_QOS
	default n
	help
	  Scale ddr freqency down threshold for HISI K3V3 platform.

config HI6XXX_DDR_DEVFREQ_DEBUGFS
	bool "Hisilicon ddr devfreq debugfs"
	depends on HI6XXX_DDR_DEVFREQ && DEBUG_FS
	default n
	help
	  This is a testing driver for HISI ddr devfreq function.

config HI3XXX_DDR_DEVFREQ
	bool "Hisilicon ddr devfreq support"
	depends on PM_DEVFREQ && PM_OPP
	select DEVFREQ_GOV_PM_QOS
	default n
	help
	  Scale ddr freqency down threshold for HI3XXX platform.

config HI3XXX_DDR_DEVFREQ_DEBUGFS
	bool "Hisilicon ddr devfreq debugfs"
	depends on HI3XXX_DDR_DEVFREQ && DEBUG_FS
	default n
	help
	  This is a testing driver for HISI ddr devfreq function.

endif # PM_DEVFREQ
```

## kernel/drivers/gpu/arm/Kconfig
```kconfig
config MALI_DEVICE
	bool "mali device"
	help

if ARCH_HI6XXX
source "drivers/gpu/arm/mali4_32/Kconfig"
source "drivers/gpu/arm/mali4_64/Kconfig"
endif

if ARCH_HI3XXX
source "drivers/gpu/arm/malit6_64/Kconfig"
endif
```

## kernel/drivers/hisi/Kconfig
```kconfig
config HISILICON_PLATFORM
	bool "Hisilicon platform support"
	default n 
	help
	  Say yes here to support the hisilicon platform


if HISILICON_PLATFORM

source "drivers/hisi/adc/Kconfig"
source "drivers/hisi/ddrc/Kconfig"
source "drivers/hisi/hifidsp/Kconfig"
source "drivers/hisi/hi6xxx/Kconfig"
source "drivers/hisi/efuse/Kconfig"
source "drivers/hisi/keymaster/Kconfig"
source "drivers/hisi/mntn/Kconfig"
source "drivers/hisi/ipc_hi6xxx/Kconfig"
source "drivers/hisi/hifi_mailbox/Kconfig"
source "drivers/hisi/modem_hi6xxx/Kconfig"
source "drivers/hisi/modem_hi3xxx/Kconfig"
source "drivers/hisi/mailbox/Kconfig"
source "drivers/hisi/mutex_service/Kconfig"
source "drivers/hisi/noc/Kconfig"
source "drivers/hisi/pm/Kconfig"
source "drivers/hisi/rdr/Kconfig"
source "drivers/hisi/socp/Kconfig"
source "drivers/hisi/tele_mntn/Kconfig"
source "drivers/hisi/mcushell/Kconfig"
source "drivers/hisi/freqdump/Kconfig"
source "drivers/hisi/hi3xxx/Kconfig"
source "drivers/hisi/axi/Kconfig"
source "drivers/hisi/hi6421_spk/Kconfig"
source "drivers/hisi/hi6402_mbhc/Kconfig"
source "drivers/hisi/hi6402dsp/Kconfig"
source "drivers/hisi/pm_common/Kconfig"
source "drivers/hisi/watchpoint/Kconfig"
source "drivers/hisi/misc/Kconfig"
source "drivers/hisi/hmpthresholds/Kconfig"
source "drivers/hisi/memory_dump/Kconfig"
endif #HISILICON_PLATFORM

if HISI_BALONG_MODEM_HI3XXX
source "drivers/hisi/efuse/Kconfig"
endif
```

## kernel/drivers/hisi/adc/Kconfig
```kconfig
config HI3XXX_HKADC
	bool "HISI ADC support"
	depends on HI3XXX_MAILBOX
	default n
	help
	  Say yes here to support the HISI ADC device

config HI3XXX_HKADC_DEBUG
	tristate "HISI ADC DEBUG"
	help
	  Say yes here to support this lock
```

## kernel/drivers/hisi/ddrc/Kconfig
```kconfig
config HISILICON_PLATFORM_DDRC
	bool "Hisilicon platform ddr controller support"
	default n
	help
	  Say yes here to support the hisilicon platform ddr controller
config HI6XXX_DDRC_PROTECT
	bool "Hisi hi6xxx ddr protect "
	depends on ARCH_HI6XXX
	default n
config HI6XXX_DDRC_FLUX
	bool "Hisi hi6xxx ddr bandwith statstic "
	depends on ARCH_HI6XXX
	default n
config HI3XXX_DDRC
	bool "hisi hi3xxx ddr test"
	depends on ARCH_HI3XXX
	default n
```

## kernel/drivers/hisi/freqdump/Kconfig
```kconfig
config HISILICON_HI6XXX_FREQDUMP
	bool "Hisilicon platform freqdump support"
	default n
	help
	  Say yes here to support the hisilicon platform freqdump.
```

## kernel/drivers/hisi/hi3xxx/Kconfig
```kconfig
comment "kernel/driver/hisi/hi3xxx/irq_affinity_debugfs.c"
config HI3XXX_IRQ_AFFINITY
	bool "Hisilicon irq affinity"
	depends on SMP
	default n
	help
	  Driver for irq affinity recovery in smp system

comment "kernel/driver/hisi/hi3xxx/irq_affinity_debugfs.c"
config HI3XXX_IRQ_AFFINITY_DEBUGFS
	bool "Hisilicon irq affinity debugfs"
	depends on HI3XXX_IRQ_AFFINITY
	default n
	help
	  Debug code for HISI irq affinity recovery in smp system

config HI3XXX_POWER_OFF
	bool "Hisilicon hi3xxx platform power off and reset driver"
	default n
	help
	  Power off and reset support for the Hisilicon HI3xxx boards

config HISI_REBOOT_TYPE
	bool "Hisilicon hi3xxx reboot type driver"
	depends on HI3XXX_POWER_OFF
	default n
	help
	  Reboot type support for the Hisilicon HI3xxx boards

config HI3XXX_CMDLINE_PARSE
       bool "cmdline parse"
       default n

       help
          Say 'Y' here if you want to support the cmdline parse

#
#Hisilicon HI3xxx SIM hotplug support.
#
config HI3XXX_SIM_HOTPLUG
	bool "support sim hotplug function"
	default n
	help
	  Say 'Y' here if you want to support the SIM HOTPLUG.

config HI3XXX_SR
	bool "support hi3xxx suspend and resume"
	depends on SUSPEND
	default n
	help
	   support hi3xxx suspend and resume

config HI3XXX_SR_DEBUG
	bool "hisi suspend-resume debug interface"
	depends on PM
	default n
	help
	suspend-resume debug for hisi platform

config HI3XXX_SR_DEBUG_SLEEP
	bool "hisi suspend-resume debug sleep"
	depends on PM
	default n
	help
	suspend-resume debug sleep for hisi platform

config HI3XXX_LPM3_DEBUG
	depends on HI3XXX_MAILBOX
	bool "Hisilicon LPM3 debug"
	default n
	help
	  Hi3xxx lpm3 debug driver

config HI3XXX_MODEM_ETB
	bool "hisi modem etb driver"
	default n
	help
	  enable etb trace for modem for hisi platform

config HISI_BOOST5V_CONTROL
	bool "support boost5v control function"
	default n
	help
	  Say 'Y' here if you want to support boost5v control enable.
config HISI_DDR_DEBUG
	bool "support converting virtual address to physical address"
	default n
	help
	  Say 'Y' here if you want to support boost5v control enable.
```

## kernel/drivers/hisi/hi6402_mbhc/Kconfig
```kconfig
config HI6402_MBHC
	tristate "Support for HI6402 MBHC"
	default n
	---help---
	 Say Y here if you want to support HI6402 MBHC
```

## kernel/drivers/hisi/hifi_mailbox/ipcm/Kconfig
```kconfig
menu "Hifi mailbox driver"

config HIFI_IPC
     bool "k3 multicore ipc driver"
     default n
     help
          k3 multicore ipc driver.
endmenu
```

## kernel/drivers/hisi/hifidsp/Kconfig
```kconfig
menu "Hifimisc driver serve HIFI dsp"

config HISILICON_PLATFORM_HIFI_DSP
     bool "hifi low power play device support"
     help
          hifi lpp device provide service for HIFI and AP, in case of HIFI ultra-low power audio play.

endmenu
```

## kernel/drivers/hisi/ipc_hi6xxx/Kconfig
```kconfig
config HI6XXX_IPC_MULTICORE
	bool "Kirin620 ipc part for multicore support"
	default n
	help
	  Say yes here to support the Kirin620 ipc part for multicore lib
```

## kernel/drivers/hisi/keymaster/Kconfig
```kconfig
config HISILICON_PLATFORM_KEYMASTER
	bool "Hisilicon platform keymaster support"
	default n
	help
	  Say yes here to support the hisilicon platform keymaster lib
```

## kernel/drivers/hisi/mailbox/Kconfig
```kconfig
source "drivers/hisi/mailbox/hi6xxx_mailbox/Kconfig"
source "drivers/hisi/mailbox/hisi_mailbox/Kconfig"
```

## kernel/drivers/hisi/mailbox/hi6xxx_mailbox/Kconfig
```kconfig
config HI6XXX_MAILBOX_MULTICORE
	bool "Kirin620 mailbox part for multicore support"
	depends on HI6XXX_MODEM_MULTICORE && HI6XXX_IPC_MULTICORE
	default n
	help
	  Say yes here to support the Kirin620 mailbox part for multicore lib
```

## kernel/drivers/hisi/mailbox/hisi_mailbox/Kconfig
```kconfig
comment "hi3xxx ipc MailBox driver"
config HI3XXX_MAILBOX
	bool "hi3xxx ipc MailBox driver"
	default n
	help
	  hi3xxx ipc MailBox driver
	  
comment "hi6xxx ipc MailBox driver"
config HI6XXX_MAILBOX
	bool "hi6xxx ipc MailBox driver"
	default n
	help
	  hi6xxx ipc MailBox driver

comment "hisi ipc mailboxes debugfs user"
config HISI_MAILBOX_DEBUGFS
	bool "hisi ipc mailboxes debugfs user"
	depends on (HI3XXX_MAILBOX || HI6XXX_MAILBOX) && DEBUG_FS
	default n
	help
	  HiIPCV230 ipc mailboxes debugfs user

comment "hisi ipc MailBox driver performance debug"
config HISI_MAILBOX_PERFORMANCE_DEBUG
	bool "hisi ipc MailBox driver performance debug"
	depends on (HI3XXX_MAILBOX || HI6XXX_MAILBOX)
	default n
	help
	  Print tts of sending task, if config is set y

comment "hi3xxx kernel API about remote processor communication"
config HI3XXX_RPROC
	bool "hi3xxx ipc kernel API"
	default n
	help
	  hi3xxx kernel API about remote processor communication
	  
comment "hi6xxx kernel API about remote processor communication"
config HI6XXX_RPROC
	bool "hi6xxx ipc kernel API"
	default n
	help
	  hi6xxx kernel API about remote processor communication

comment "hisi rproc kernel API debugfs"
config HISI_RPROC_DEBUGFS
	bool "hisi rproc kernel API debugfs"
	depends on (HI3XXX_RPROC || HI6XXX_RPROC) && DEBUG_FS
	default n
	help
	  debug for hisi_rproc
```

## kernel/drivers/hisi/mntn/Kconfig
```kconfig
config HISILICON_PLATFORM_MAINTAIN
	bool "Hisilicon platform maintain module support"
	default n
	help
	  Say yes here to support the hisilicon platform maintain module 

config HISILICON_PLATFORM_HISI_EASYSHELL
	bool "Support HiSilicon Hi6XXX Easy Shell"
	default n
	help
	  This driver supports HiSilicon HiXXX SOC,
	  including easy shell, etc.
```
