## kernel/drivers/hisi/modem_hi6xxx/drv/acore/interface/Kconfig
```kconfig
config HI6XXX_PLATFORM_INTERFACE
	bool "Hisilicon Kirin620 platform interface lib support"
	depends on HI6XXX_MODEM_PLATFORM
	default n
	help
	  Say yes here to support the hisilicon kirin620 platform interface lib
```

## kernel/drivers/hisi/modem_hi6xxx/drv/acore/ipf/Kconfig
```kconfig
config HI6XXX_PLATFORM_IPF
	bool "Hisilicon Kirin620 platform IPF support"
	depends on HI6XXX_MODEM_PLATFORM
	default n
	help
	  Say yes here to support the hisilicon kirin620 platform ipf driver
```

## kernel/drivers/hisi/modem_hi6xxx/drv/acore/nvim/Kconfig
```kconfig
config HISILICON_PLATFORM_NVIM
	bool "Hisilicon platform nvim support"
	default n
	help
	  Say yes here to support the hisilicon platform nvim
```

## kernel/drivers/hisi/modem_hi6xxx/drv/acore/om/Kconfig
```kconfig
config HI6XXX_PLATFORM_OM
	bool "Hisilicon Kirin620 platform om support"
	depends on HI6XXX_MODEM_PLATFORM
	default n
	help
	  Say yes here to support the hisilicon kirin620 platform om driver
```

## kernel/drivers/hisi/modem_hi6xxx/drv/acore/rfile/Kconfig
```kconfig
config HI6XXX_PLATFORM_REMOTE_FILE
	bool "Hisilicon Kirin620 platform remote file system support"
	depends on HI6XXX_MODEM_PLATFORM
	default n
	help
	  Say yes here to support the hisilicon kirin620 platform remote file system 
```

## kernel/drivers/hisi/modem_hi6xxx/drv/acore/subvic/Kconfig
```kconfig
config HISILICON_PLATFORM_SUBVIC
	bool "Hisilicon platform subvic support"
	default n
	help
	  Say yes here to support the hisilicon platform subvic
```

## kernel/drivers/hisi/modem_hi6xxx/drv/acore/sync/Kconfig
```kconfig
config HISILICON_PLATFORM_SYNC
	bool "Hisilicon platform synchronizer support"
	default n
	help
	  Say yes here to support the hisilicon platform synchronizer
```

## kernel/drivers/hisi/modem_hi6xxx/drv/acore/timer/Kconfig
```kconfig
config HI6XXX_PLATFORM_TIMER
	bool "Hisilicon Kirin620 platform timer support"
	depends on HI6XXX_MODEM_PLATFORM
	default n
	help
	  Say yes here to support the hisilicon kirin620 platform timer 
```

## kernel/drivers/hisi/modem_hi6xxx/drv/acore/udi/Kconfig
```kconfig
config HISILICON_PLATFORM_UDI
	bool "Hisilicon platform udi support"
	default n
	help
	  Say yes here to support the hisilicon platform udi
```

## kernel/drivers/hisi/modem_hi6xxx/drv/acore/usb/Kconfig
```kconfig
config HISILICON_PLATFORM_USB
	bool "Hisilicon platform usb support"
	default n
	help
	  Say yes here to support the hisilicon platform usb
```

## kernel/drivers/hisi/noc/Kconfig
```kconfig
config HISILICON_PLATFORM_NOC
	bool "Support HiSilicon NOC"
	default n
	help
	  This driver supports HiSilicon HiXXX NOC,
	  including hisilicon noc driver.

config HISI_NOC
	bool "Support HiSilicon Hisi NOC"
	default n
	help
	  This driver supports HiSilicon Hi6XXX NOC,
	  including hisilicon noc driver.
	  
config HISI_NOC_HI6220_PLATFORM
	depends on HISI_NOC
	bool "Support HiSilicon Hisi NOC"
	default n
	help
	   platform
	   
config HISI_NOC_HI3635_PLATFORM
	depends on HISI_NOC
	bool "Support HiSilicon Hisi NOC"
	default n
	help
	   platform
	   
config HISI_NOC_HI3650_PLATFORM
	depends on HISI_NOC
	bool "Support HiSilicon Hisi NOC"
	default n
	help
	   platform	   
```

## kernel/drivers/hisi/pm/Kconfig
```kconfig
config HISILICON_PLATFORM_POWER_CONTROL
	bool "Support HiSilicon Hi6XXX Power Control"
	depends on ARCH_HI6XXX
	default n
	help
	  This driver supports HiSilicon HiXXX Power Control,
	  including hisilicon hi6xxx power control driver, etc.

config HISILICON_PLATFORM_PM_DFS
	bool "Support HiSilicon Hi6XXX Power Control DFS"
	depends on ARCH_HI6XXX
	default n
	help
	  This driver supports HiSilicon HiXXX Power Control,
	  including hisilicon hi6xxx power control driver, etc.

config HISILICON_PLATFORM_PM_SLEEP
	bool "Support HiSilicon Hi6XXX Power Control Sleep"
	depends on ARCH_HI6XXX
	default n
	help
	  This driver supports HiSilicon HiXXX Power Control,
	  including hisilicon hi6xxx power control driver, etc.
```

## kernel/drivers/hisi/pm_common/Kconfig
```kconfig
#
#Hisilicon suspend optimization support.
#
comment "kernel/driver/hisi/pm_common/suspend.c"
config HISI_SR
	bool "Hisilicon suspend optimization"
	depends on SUSPEND
	default n
	help
	  Driver for suspend optimization
```

## kernel/drivers/hisi/rdr/Kconfig
```kconfig
menu "Kernel run data recorder menu"

config HISI_RDR
	bool "kernel run data recorder"
	depends on SYSFS
	default n
	help
	  This module can record some data about kernel internal info.
	  Include:
	  the task switch,
	  interrupts switch,
	  arm exception info,
	  etc ...

config HISI_RDR_TEST
	bool "test unit for kernel run data recorder"
	depends on SYSFS && HISI_RDR
	default y
	help
	  This module can test RDR function ...
	  Include:
	  dataabort,
	  etc

config HISI_RDR_SWITCH
	bool "task switch, interrupts switch, system call switch setting"
	depends on SYSFS && HISI_RDR
	default n
	help
	  This module can open or close task switch, int_switch, system call switch
	  Includes:
	  interrupts switch,
	  system call switch,
	  task_switch
	  if select n,then trace these options.
	  if select y,then stop trace.

config HIFI_RESET
	bool "hifi reset switch"
	default n
	help
	  hifi reset
endmenu
```

## kernel/drivers/huawei_platform/Kconfig
```kconfig
source "drivers/huawei_platform/camera_legacy/Kconfig"
source "drivers/huawei_platform/connectivity/Kconfig"
source "drivers/huawei_platform/dsm/Kconfig"

config SENSORHUB_FEATURE_SUPPORT
	bool "Huawei sensorhub support, for onetrack"
	default n
	help
	Say yes here to support the huawei platform


menu "huawei linux device driver support"
source "drivers/huawei_platform/sensor/Kconfig"
source "drivers/huawei_platform/inputhub/Kconfig"
source "drivers/huawei_platform/touthscreen/Kconfig"
source "drivers/huawei_platform/irda/Kconfig"
source "drivers/huawei_platform/log/Kconfig"
source "drivers/huawei_platform/nfc/Kconfig"
source "drivers/huawei_platform/usb/Kconfig"
source "drivers/huawei_platform/ext_modem/Kconfig"
source "drivers/huawei_platform/storage/Kconfig"
source "drivers/huawei_platform/chipverification/Kconfig"
source "drivers/huawei_platform/chr/Kconfig"
endmenu

source "drivers/huawei_platform/audio/Kconfig"
source "drivers/huawei_platform/antenna_fpga/Kconfig"

source "drivers/huawei_platform/power/Kconfig"
```

## kernel/drivers/huawei_platform/audio/Kconfig
```kconfig
source "drivers/huawei_platform/audio/max98925/Kconfig"
source "drivers/huawei_platform/audio/speakerID/Kconfig"
source "drivers/huawei_platform/audio/anc_hs/Kconfig"
source "drivers/huawei_platform/audio/tfa9895/Kconfig"
source "drivers/huawei_platform/audio/earpiece_pa/Kconfig"
```

## kernel/drivers/huawei_platform/audio/max98925/Kconfig
```kconfig
config MAX98925
	tristate "max98925 i2c driver"
	default n
	help
		Say Y to enable max98925 i2c driver support
```

## kernel/drivers/huawei_platform/audio/speakerID/Kconfig
```kconfig
config SPEAKERID
	tristate "speakerID driver"
	default n
	help
		Say Y to enable speakerID driver support
```

## kernel/drivers/huawei_platform/connectivity/bcm/wifi/driver/bcmdhd/Kconfig
```kconfig
config BCMDHD
	tristate "Broadcom FullMAC wireless cards support"
	select WIRELESS_EXT
	select WEXT_PRIV
	select WEXT_SPY
	---help---
	  This module adds support for wireless adapters based on
	  Broadcom FullMAC chipset.

	  If you choose to build a module, it'll be called dhd. Say M if
	  unsure.

config BCM4330
	tristate "Broadcom 4330 wireless cards support"
	depends on WLAN
	---help---
	  This module adds support for wireless adapters based on
	  Broadcom 4330 chipset.

config BCM4334
	tristate "Broadcom 4334 wireless cards support"
	depends on WLAN
	---help---
	  This module adds support for wireless adapters based on
	  Broadcom 4334 chipset.

config BCM4335
	tristate "Broadcom 4335 wireless cards support"
	depends on WLAN
	---help---
	  This module adds support for wireless adapters based on
	  Broadcom 4335 chipset.

config BCM4339
	tristate "Broadcom 4339 wireless cards support"
	depends on WLAN
	---help---
	  This module adds support for wireless adapters based on
	  Broadcom 4339 chipset.

config BCM4354
	tristate "Broadcom 4354 wireless cards support"
	depends on WLAN
	---help---
	  This module adds support for wireless adapters based on
	  Broadcom 4354 chipset.

config BCM4343
	tristate "Broadcom 4343 wireless cards support"
	depends on WLAN
	---help---
	  This module adds support for wireless adapters based on
	  Broadcom 4343 chipset.
	  
config BCMDHD_SDIO
	bool "SDIO bus interface support"
	depends on BCMDHD && MMC
	default y

config BCMDHD_PCIE
	bool "PCIe bus interface support"
	depends on BCMDHD && PCI && !BCMDHD_SDIO

config BCMDHD_FW_PATH
	depends on BCMDHD
	string "Firmware path"
	default "/system/vendor/firmware/fw_bcmdhd.bin"
	---help---
	  Path to the firmware file.

config BCMDHD_NVRAM_PATH
	depends on BCMDHD
	string "NVRAM path"
	default "/system/etc/wifi/bcmdhd.cal"
	---help---
	  Path to the calibration file.

config BCMDHD_WEXT
	bool "Enable WEXT support"
	depends on BCMDHD && CFG80211 = n
	select WIRELESS_EXT
	select WEXT_PRIV
	help
	  Enables WEXT support

config DHD_USE_STATIC_BUF
	bool "Enable memory preallocation"
	depends on BCMDHD
	default n
	---help---
	  Use memory preallocated in platform

config DHD_USE_SCHED_SCAN
	bool "Use CFG80211 sched scan"
	depends on BCMDHD && CFG80211
	default n
	---help---
	  Use CFG80211 sched scan

config BCM_VIO
	tristate "BCM VIO support"
	depends on BCMDHD

config HW_WIFI_FREQ_CTRL_FLAG
	tristate "wifi dynamic frequency adjust support"
	depends on BCMDHD
```

## kernel/drivers/huawei_platform/connectivity/hisi/Kconfig
```kconfig
#
# Generic huawei hisi misc drivers configuration
#

menuconfig CONNECTIVITY_HI110X 
    bool "Huawei BFG & WiFi Driver"
	help
	  This is hw-pm and hw-ps oamdrv wifi driver for huawei hisi.
	select HW_INI
	select HI1101_WIFI
	select HW_PM
	select HW_PS
	select HW_CHR
    help
        This enables the wireless pm driver for Huawei
        BT / FM / GNSS /WiFi chips. 

if CONNECTIVITY_HI110X 
source "drivers/huawei_platform/connectivity/hisi/hw-chr/Kconfig"
source "drivers/huawei_platform/connectivity/hisi/hw-ini/Kconfig"
source "drivers/huawei_platform/connectivity/hisi/hw-pm/Kconfig"
source "drivers/huawei_platform/connectivity/hisi/hw-ps/Kconfig"
source "drivers/huawei_platform/connectivity/hisi/oam-drv/Kconfig"
source "drivers/huawei_platform/connectivity/hisi/hisiwifi/Kconfig"
endif 
```

## kernel/drivers/huawei_platform/connectivity/hisi/hisiwifi/Kconfig
```kconfig
config HI110X_WIFI_ENABLE
	bool

config HI1101_WIFI
	tristate "Hisilicon 1101 wireless cards support"
	depends on MMC && WLAN && MMC
	default n
	select HI110X_WIFI_ENABLE
	---help---
	This module adds support for wireless adapters based on
	Hisilicon 1101 chipset.

	This driver uses the kernel's wireless extensions subsystem.

	If you choose to build a module, it'll be called dhd. Say M if
        unsure.
```

## kernel/drivers/huawei_platform/connectivity/hisi/hw-chr/Kconfig
```kconfig
#
# Huawei's public serial driver and the protocol
# drivers (BT, FM and GNSS)
#

config HW_CHR
	tristate "huawei chr_dev driver for BFGN log"
	default n
	help
	  This enables the  chr_dev driver for Huawei
	  WIFI/ BT / FM / GNSS chips log. 
```

## kernel/drivers/huawei_platform/connectivity/hisi/hw-ini/Kconfig
```kconfig
#
# Huawei's wireless_pm driver for
# drivers (BT, FM and GNSS)
#

config  HW_INI
	tristate "huawe ini_drv driver"
	default n
	help
		find the value of host var in .ini file
```

## kernel/drivers/huawei_platform/connectivity/hisi/hw-pm/Kconfig
```kconfig
#
# Huawei's wireless_pm driver for
# drivers (BT, FM and GNSS)
#

config  HW_PM
	tristate "huawei wireless_pm driver"
	default n
	help
	  This enables the wireless pm driver for Huawei
	  BT / FM / GNSS chips. 
```

## kernel/drivers/huawei_platform/connectivity/hisi/hw-ps/Kconfig
```kconfig
#
# Huawei's public serial driver and the protocol
# drivers (BT, FM and GNSS)
#

config HW_PS
	tristate "huawei public serial driver"
	default n
	help
	  This enables the public serial driver for Huawei
	  BT / FM / GNSS chips. This enables protocol drivers
	  to register themselves and send data, the responses
	  are returned to relevant protocol drivers based on their
	  packet types.
```
