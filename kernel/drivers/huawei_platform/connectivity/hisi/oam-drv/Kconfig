## kernel/drivers/huawei_platform/connectivity/hisi/oam-drv/Kconfig
```kconfig
#
# Kconfig for huawei's oam driver
#

config OAM_DRV
	tristate "oam drv for wifi driver"
	default m
	help
	  This driver used by the wifi driver send dbg log to sdt;
	  used to link wifi driver and oam_app;
	  this is a interface code
```

## kernel/drivers/huawei_platform/ext_modem/Kconfig
```kconfig
menu "huawei 3rdmodem linux driver"
source "drivers/huawei_platform/ext_modem/viacbp82d/Kconfig"
endmenu
```

## kernel/drivers/huawei_platform/ext_modem/viacbp82d/Kconfig
```kconfig
#
# via cbp 8.2 driver configuration
#
config VIACBP82D_3RD_MODEM
	bool "misc via Support"
	default n
	help
	  This allows misc via.
	  If unsure, say n.
config VIACBP82D_3RD_MODEM_SPI
    bool "misc VIA SPI Support"
    default n
    help
      This allows misc VIA modem through SPI.
      If unsure, say n.
```

## kernel/drivers/huawei_platform/power/Kconfig
```kconfig
source "drivers/huawei_platform/power/charger/Kconfig"
source "drivers/huawei_platform/power/hw_kstate/Kconfig"
source "drivers/huawei_platform/power/ate/Kconfig"
source "drivers/huawei_platform/power/bastet/Kconfig"
source "drivers/huawei_platform/power/smpl/Kconfig"
```

## kernel/drivers/huawei_platform/touthscreen/Kconfig
```kconfig
#
# huawei touchscreen driver configuration
#

config HUAWEI_TS
	bool "huawei touchscreen"
	default n
	help
	  If you say yes here you get support for huawei touchscreen.
	  
config HUAWEI_TS_TEST
	bool "huawei touchscreen test"
	default n
	help
	  If you say yes here you get support for huawei touchscreen.

source "drivers/huawei_platform/touthscreen/panel/Kconfig"
source "drivers/huawei_platform/touthscreen/panel/cyttsp5/Kconfig"

#sensor unification for differ platform
menu "huawei linux device driver support package"
config HUAWEI_TP_COLOR_INFO
	bool "huawei tp color info"
	default n
	help
		get the huawei tp color information.
endmenu
```

## kernel/drivers/huawei_platform_legacy/Kconfig
```kconfig
config SEATTLE
      bool "seattle"
      default n

source "drivers/huawei_platform_legacy/Seattle/Kconfig"
```

## kernel/drivers/huawei_platform_legacy/Seattle/power/Kconfig
```kconfig
config POWER_HUAWEI_S
        bool "security device module"
        default n
config BATTERY_COULOMB_TEST_INTERFACE_S
	bool "coulomb test interface"
	default n
config BATTERY_HISI_HI6421V300_S
	bool "hisi hi6421v300"
	default n
config BATTERY_HISI_COUL_S
        bool "hisi coul"
        default n
config BATTERY_HISI_COUL_TEST_S
        bool "hisi coul test"
        default n
config BQ_BCI_BATTERY_S
        bool "bq bci bqttery"
        default n
```

## kernel/drivers/media/huawei/camera/Kconfig
```kconfig
comment "Huawei Camera"

source "drivers/media/huawei/camera/isp/Kconfig"
source "drivers/media/huawei/camera/sensor/Kconfig"

menuconfig HUAWEI_CAMERA_USE_EXTISP
    bool "Huawei external ISP support"
    default n
    select SPI
    help
        Say Y here to enable external ISP for Huawei camera

if HUAWEI_CAMERA_USE_EXTISP
source "drivers/media/huawei/camera/extisp/Kconfig"
endif
```

## kernel/drivers/mmc/Kconfig
```kconfig
#
# MMC subsystem configuration
#

menuconfig MMC
	tristate "MMC/SD/SDIO card support"
	depends on HAS_IOMEM
	help
	  This selects MultiMediaCard, Secure Digital and Secure
	  Digital I/O support.

	  If you want MMC/SD/SDIO support, you should say Y here and
	  also to your specific host controller driver.

config MMC_DEBUG
	bool "MMC debugging"
	depends on MMC != n
	help
	  This is an option for use by developers; most people should
	  say N here.  This enables MMC core and driver debugging.

 config HUAWEI_SDCARD_DSM
	bool "Listen sdcard kernel err"
	depends on MMC != n
	default y
	help
	   use huawei sdcard log radar
config HUAWEI_EMMC_DSM
	bool "Listen eMMC kernel err"
	depends on MMC != n
	default n
	help
	   use huawei emmc log radar

config HUAWEI_EMMC_DSM_ONLY_VDET
	bool "Listen eMMC low voltage err"
	depends on MMC != n
	default n
	help
	   use device radar only to record emmc vdet log
if MMC

source "drivers/mmc/core/Kconfig"

source "drivers/mmc/card/Kconfig"

source "drivers/mmc/host/Kconfig"

endif # MMC
```

## kernel/drivers/power/huawei/Kconfig
```kconfig
config BATTERY_HI6XXX_SMARTSTAR
	bool "hi6xxx smartstar"
	default n
config BATTERY_HISI_COUL
        bool "hisi coul"
        default n
config BQ_BCI_BATTERY
        bool "bq bci battery"
        default n
config HI6521_CHARGER
        bool "hi6xxx hi6521 charger"
        default n
config CHARGER_TYPE_RECHECK
        bool "hi6xxx charger type recheck"
        default n
config HUAWEI_HLTHERM_CHARGING
         bool "High and low tem charging"
config COUL_TEST
        bool "hisi coul test"
        default n
```

## kernel/drivers/staging/pasr/Kconfig
```kconfig
config ARCH_HAS_PASR
	bool

config PASR
	bool "DDR Partial Array Self-Refresh"
	depends on ARCH_HAS_PASR
	---help---
	  PASR consists on masking the refresh of unused segments or banks
	  when DDR is in self-refresh state.

config HI6210_PASR
	bool "HI6210 PASR driver"
	def_bool y
	depends on (PASR && ARCH_HI6XXX)
	---help---
	  PASR support for Hi6210 & Hi6220 board.

config HI3635_PASR
	bool "HI3635 PASR driver"
	def_bool y
	depends on (PASR && ARCH_HI3XXX)
	---help---
	  PASR support for Hi3635 board.

config PASR_DEBUG
	bool "Add PASR debug prints"
	def_bool y
	depends on PASR
```

## kernel/drivers/tzdriver/Kconfig
```kconfig
config SECURE_EXTENSION
        bool "security extension support"
        default n
        help
          Include Security Extension.

config  TZDRIVER
    tristate "Secure Execution Communicator driver"
    default n
    depends on SECURE_EXTENSION
    help
      Provides a communication interface between userspace and
      TrustZone Operating Environment.

config TEELOG
       tristate "Secure Execution Communicator driver"
       default n
       depends on TZDRIVER && ARCH_HI3XXX
       help
       TEEOS log
```

## kernel/drivers/vcodec/chipmedia/Kconfig
```kconfig
menuconfig VIDEO_HI6210_CODEC
    tristate "Hi6210 Support C&M Video Codec Drivers"
    default n
    ---help---
      This is the codec driver based on hi6210.

if VIDEO_HI6210_CODEC
source "drivers/vcodec/chipmedia/vpu/Kconfig"
endif
```

## kernel/drivers/vcodec/chipmedia/vpu/Kconfig
```kconfig
#
# VPU driver configuration
#

config CNM_VPU
    tristate "Support C&M VPU Codec"
    default n
    help
        The device provides codec function for video

config CNM_VPU_HISI_PLATFORM
    bool "Hisilicon Platform Isolated macro"
    depends on CNM_VPU
    default y
    help
        The device provides codec function for video
```

## kernel/drivers/vcodec/imagination/Kconfig
```kconfig
menuconfig IMAGINATION_VCODEC
    tristate "Hi3xxx Support IMG Video Codec Drivers"
    default n
    ---help---
      This is the codec driver based on hi3xxx.

if IMAGINATION_VCODEC      
source "drivers/vcodec/imagination/imgvideo/Kconfig"
source "drivers/vcodec/imagination/vdec/Kconfig"
source "drivers/vcodec/imagination/encode/Kconfig"
endif
```

## kernel/drivers/vcodec/jpu/v3_jpu/Kconfig
```kconfig
menu "JPEG decode support"

config JPEG_CODEC
    #depends on ANDROID_PMEM
    tristate "Support for hisi k3 Jpeg dec processor"
    default n
    help
        The decode device provides decode function for Jpeg
endmenu
```

## kernel/drivers/vcodec/jpu/v8_jpu/Kconfig
```kconfig
#
# JPU driver configuration
#

config CNM_JPU
    tristate "Support C&M JPU Codec"
    default n
    help
        The device provides codec function for jpeg



config CNM_JPU_HISI_PLATFORM
    bool "Hisilicon Platform Isolated macro"
    depends on CNM_JPU
    default y
    help
        The device provides codec function for jpeg
```

## kernel/drivers/vcodec/vpp/Kconfig
```kconfig
config HIK3_VPP
    tristate "vpp driver"
    default n
    ---help---
        This is the vpp driver
```

## kernel/drivers/video/hisilicon/Kconfig
```kconfig
config FB_HI3620
	tristate "Hisilicon Hi3620 Frame Buffer support"
	depends on FB && ARCH_HS
	select FB_CFB_FILLRECT
	select FB_CFB_COPYAREA
	select FB_CFB_IMAGEBLIT
	select FB_MODE_HELPERS
	select VIDEOMODE_HELPERS
	help
	  This is the frame buffer device driver for the Hisilicon Hi3620 LCD
	  controller.
```

## kernel/sound/soc/hisilicon/Kconfig
```kconfig
menu "SoC Audio support for HI3630"

config SND_SOC_PCM_HI3630
	tristate "SoC Audio support for HI3630"
	help
	  Say y to enable this option for HI3630 I2S audio support.

config SND_HI3630_HI6401
	tristate "Hi3630-Hi6401 sound support"
	help
	  Say y to enable sound support for Hi3630-Hi6401
	  
config SND_HI3630_HI6402
	tristate "Hi3630-Hi6402 sound support"
	help
	  Say y to enable sound support for Hi3630-Hi6402

config SND_SOC_PCM_HI6210
	tristate "SoC Audio support for HI6210"
	help
		Enable this option for HI6210 APB audio support.
config SND_HI6210_HISSC
	tristate "Hi6210-Hissc sound support"
	help
		This option enables sound support for Hi6210-Hissc.
		ssc mean Soc-Smartstar Codec.
endmenu
```
